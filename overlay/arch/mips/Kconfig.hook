## overlay/arch/mips/Kconfig.hook
```kconfig
menu "RTK Luna Selection"
config BOARD_REALTEK_TYPE
	bool

config SYSTEM_CAPABILITY
        prompt "System Capability"
        string
        default "0;4;2;2;1;1"
        help
                System Capability, format FE;GE;VOIP;USB;2.4G;5G

config UNI_CAPABILITY
	prompt "UNI port Capability"
	string
	help
		UNI port Capability, format is [2/1/0];[2/1/0];[2/1/0];[2/1/0];[2/1/0]
		GE port is 2, FE port is 1, None is 0
		The port number should follow CHIP spec. ex. 9607C has 5 uni ports.

config OMCI_CLAIM_UNI_CAPABILITY
	prompt "OMCI claim UNI port Capability"
	string
	default UNI_CAPABILITY
	help
		OMCI claim UNI port Capability, format is [2/1/0];[2/1/0];[2/1/0];[2/1/0];[2/1/0]
		GE port is 2, FE port is 1, None is 0
		The port number should follow CHIP spec. ex. 9607C has 5 uni ports.

		The purpose of this is providing information about UNI capability
		to OMCI to report.

config E8B
        bool "Support for CTC E8B requirement"

config YUEME
        bool "Support for CTC YueMe requirement"
        depends on E8B

config CTC_AWIFI_KERNEL_JITUAN
        bool "Jituan kernel feature"
        depends on YUEME

config CMCC
        bool "Support for CMCC requirement"

config CMCC_2023_NEWREQUIREMENT
        bool "Support for 2023 CMCC requirement"
        depends on CMCC

config CMCC_ENTERPRISE
	bool "CMCC  Enterprise Gateway requirement"
	depends on CMCC

config CU
        bool "Support for CU requirement"

config CU_BASEON_YUEME
		bool "CU DBUS firmware based on Yueme"
		depends on CU

config CU_BASEON_CMCC
		bool "CU OSGI firmware based on CMCC"
		depends on CU

config CTC_SDN
        bool "Support for CTC SDN requirement"
		depends on E8B

config TELMEX
		bool "Support for TELMEX requirement"
		select TELMEX_DEV

config TELMEX_DEV
		bool "Support for TELMEX DEV requirement"
		depends on TELMEX

config TRUE
        bool "Support for TRUE requirement"

config CONTROL_SERIAL_INPUT
	bool "support control serial input"
	depends on CTC_SDN
	default y
	help
	support to disable/enable serial input

config JIO
	bool "Support for JIO requirement"

config MGTS
	bool "Support for MGTS requirement"

config 00R0
	bool "Support for rostelecom requirement"

config YUEME_DPI
        bool "Support for CTC YueMe DPI requirement"
        depends on YUEME

config CMCC_GBM
	bool "Support for CMCC Jembench test requirement"
	depends on CMCC || CU_BASEON_CMCC

config CMCC_GBM_TIME_FACTOR_SETTING
	bool "Support for CMCC Jembench test requirement:support modify jem time factor"
	depends on CMCC_GBM

config CMCC_DMIPS
	bool "CMCC  test requirement"
	depends on CMCC || CU_BASEON_CMCC

config TELEFONICA
    bool "Support for TELEFONICA requirement"

config DBUS_FRAMEWORK_PATH
        prompt "Dbus Framework path"
        string
        default "/opt/upt"
        depends on YUEME || CU_BASEON_YUEME

choice
        prompt "Flash Size"
        default 64M_FLASH

config 4M_FLASH
        bool "4M"

config  8M_FLASH
        bool "8M"

config  16M_FLASH
        bool "16M"

config  32M_FLASH
        bool "32M"

config  48M_FLASH
        bool "48M"

config  64M_FLASH
        bool "64M"

endchoice

config FLASH_SIZE
        hex
        default "400000" if 4M_FLASH
        default "800000" if 8M_FLASH
        default "1000000" if 16M_FLASH
        default "2000000" if 32M_FLASH
        default "3000000" if 48M_FLASH
        default "4000000" if 64M_FLASH
        default "4000000"

config RTK_SOC
        bool "RTK SoC Drivers Support"
        default n
        help
          Build drivers/soc/realtek folder.

config RTK_PROC_GPIO_FILES
        bool "RTK proc gpio files Support"
        depends on RTK_SOC
        default n
        help
          Build drivers/soc/realtek folder.

choice
        prompt "LED Style"
        default GPIO_LED_TR068

config NO_LED_STYLE
	depends on RTK_PROC_GPIO_FILES
	bool "no LED Style"

config GPIO_LED_TR068
        depends on RTK_PROC_GPIO_FILES
        bool "TR068"
endchoice

config RTL8672_SW_USB_LED
        tristate "Support Software USB LED"
        depends on RTK_PROC_GPIO_FILES
        depends on USB

config SW_USB_LED0
        bool "Software USB LED 0"
        depends on RTK_PROC_GPIO_FILES
        depends on RTL8672_SW_USB_LED

config SW_USB_LED1
        bool "Software USB LED 1"
        depends on RTK_PROC_GPIO_FILES
        depends on RTL8672_SW_USB_LED

config WIFI_LED_USE_SOC_GPIO
	bool "Support using SoC gpio for WIFI LED"
	depends on RTK_PROC_GPIO_FILES
	default n
	help
		WIFI LED.

config  WPS_LED
        bool "Support WPS LED"
        default n
        depends on RTK_PROC_GPIO_FILES
        #depends on WIFI_SIMPLE_CONFIG
	help
		WPS LED Support.

config ONE_WPS_LED
        bool "Only one WPS LED"
        depends on WPS_LED
	help
		If target board has only one LED, must choose this config.

config RTK_RESET_WPS_SHARE_LED
	bool "WPS led shared with System led"
	depends on WPS_LED
	default n
	help
		This config used for the WPS/System share led board.

config RTK_RESET_WPS_SHARE_BUTTON
	bool "WPS pin shared with RESET button"
        depends on RTK_PROC_GPIO_FILES
	default n
	help
		This config used for the WPS/RESET share button board.

config PUSHBUTTON_USE_EVENT_HANDLE
	bool "Support using push button by event handler"
	select GPIOLIB
	select GPIO_SYSFS
	select INPUT
	select INPUT_POLLDEV
	select INPUT_EVDEV
	select INPUT_KEYBOARD
	select KEYBOARD_GPIO

config KERNEL_STACK_SIZE_ORDER
	int "Kenel Stack Size Order Configuration"
	default "2" if RTK_SOC_RTL9607C
	default "1"
	help
	 With Page Size 4K
	 1 for 8K kenel stack size
	 2 for 16K kernel stack size
	 3 for 32K kernel stack size
	 etc...

config RTK_NIC_RX_POOL
        bool "RTK NIC RX Pool Support"
        default n
        help
          This enables kernel support for NI driver rx pool function.
          If you would like to have NI driver rx pool support, say 'Y'.

config RTK_NIC_HWLOOKUP_DEAMSDU_OFFLOAD
        bool "RTK NIC HWLOOKUP deamsdu offload"
        default n
        help
          This enables kernel support for NI driver tx offloading WNIC deamsdu function.
          If you would like to have WNIC do not deamsdu and pass to NIC tx, say 'Y'.

config RTK_NIC_HWLOOKUP_SNAP_TRANSFORM_BY_TX_DESC
        bool "RTK NIC HWLOOKUP snap transform by tx desc"
        depends on RTK_NIC_HWLOOKUP_DEAMSDU_OFFLOAD
        default n
        help
          This enables kernel support for NI driver tx offloading WNIC snap packets.
          If you would like to have NIC tx with two desc without memmove, say 'Y'.

config DEFAULT_CONSOLE_OFF
	bool "Default close console"
	depends on RTL9607C_SERIES
	default n

config RTK_USE_TIMER_MIN_ADJUST
	bool "Enable Kernel GENERIC_CLOCKEVENTS_MIN_ADJUST"
	default y

endmenu
```

## overlay/arch/mips/rtl9607c/Kconfig
```kconfig
#
# Realtek Semiconductor Corp.
#
# RLX Linux Kernel Configuration
#
# Tony Wu (tonywu@realtek.com)
# Dec. 07, 2008
#

source "arch/mips/rtl9607c/config.top"

choice
	prompt "Realtek MIPS based SoC"
	depends on RTK_MIPS_SOC

config RTK_SOC_RTL8198D
	bool "Realtek RTL8198D SoC"
	select ARCH_HAS_PHYS_TO_DMA
	select CPU_SUPPORTS_32BIT_KERNEL
	select SYS_HAS_CPU_MIPS32_R2
	select SYS_HAS_EARLY_PRINTK
	select SYS_SUPPORTS_32BIT_KERNEL
	select SYS_SUPPORTS_BIG_ENDIAN
	select CPU_MIPSR2_IRQ_VI if SOC_ENABLE_IRQ_VI
	select CPU_MIPSR2_IRQ_EI if SOC_ENABLE_IRQ_EI
	select HW_HAS_USB if SOC_ENABLE_USB
	select SMP if SOC_ENABLE_SMP
	select DMA_NONCOHERENT
	select CPU_HAS_FPU if SOC_ENABLE_FPU
	select HARDWARE_WATCHPOINTS if SOC_ENABLE_WATCH
	select HAS_DMA
	select USE_OF if SOC_ENABLE_OF
	select BUILTIN_DTB if SOC_ENABLE_BUILTIN_DTB
	select CPU_HAS_L2C if SOC_ENABLE_L2C
        select RTK_DEV_AP
	select RTL8672
	select RTL9607C
	select CPU_HAS_WB
	select GPIOLIB_IRQCHIP
	select COMMON_CLK_RTK_APRO
	select MIPS_DISABLE_VDSO if !SOC_ENABLE_MIPS_VDSO
	select MIPS_CPU_SCACHE

config RTK_SOC_RTL9607C
	bool "Realtek RTL9607C SoC"
	select ARCH_HAS_PHYS_TO_DMA
	select CPU_SUPPORTS_32BIT_KERNEL
	select SYS_HAS_CPU_MIPS32_R2
	select SYS_HAS_EARLY_PRINTK
	select SYS_SUPPORTS_32BIT_KERNEL
	select SYS_SUPPORTS_BIG_ENDIAN
	select CPU_MIPSR2_IRQ_VI if SOC_ENABLE_IRQ_VI
	select CPU_MIPSR2_IRQ_EI if SOC_ENABLE_IRQ_EI
	select HW_HAS_USB if SOC_ENABLE_USB
	select SMP if SOC_ENABLE_SMP
	select DMA_NONCOHERENT
	select CPU_HAS_FPU if SOC_ENABLE_FPU
	select HARDWARE_WATCHPOINTS if SOC_ENABLE_WATCH
	select HAS_DMA
	select USE_OF if SOC_ENABLE_OF
	select BUILTIN_DTB if SOC_ENABLE_BUILTIN_DTB
	select CPU_HAS_L2C if SOC_ENABLE_L2C
	select RTL8672
	select RTL9607C
	select CPU_HAS_WB
	select GPIOLIB_IRQCHIP
	select COMMON_CLK_RTK_APRO
	select MIPS_DISABLE_VDSO if !SOC_ENABLE_MIPS_VDSO
	select MIPS_CPU_SCACHE

endchoice

config RTK_DEV_AP
        bool "Realtek Device type Wifi AP"
        help
          This product is designed for Wifi AP.

config RTK_DEV_APROUTER_ONLY
	bool "AP-Router only"
	default n
	help
          AP-Router Only

config USB_9607C_EHCI2
    bool "Enable 2nd EHCI controller on 9607C"
    depends on RTL9607C
    default n
    help
      Enables 2nd EHCI(EHCI2) controller on RTL9607C platform. Only one of XHCI/EHCI2 can be used.
      This option overwrites XHCI.

config RTK_USB_TEST
	bool "Enable USB Test"
	default y
	help
	Create entries under /sys/bus/usb/devices/usbX for USB test (i.e. test packet)

config RTL8672
        bool

config SOC_TIMER
	bool "Use SOC Timer"
	depends on RTL9607C
	select TIMER_OF
    default y if RTL9603CVD_SERIES
    help
      Enable SOC Timer for clockevent and clocksource.
      This should be used if CPU clock is expected to changed dynamically.

config RTL9607C
        bool
		select CPU_HAS_DSP
config RTK_LED_V074
        bool "Support V074 board led gpio"
	default n
#
# CPU
#
config CPU_MIPS4K
	bool
	default y if SOC_CPU_MIPS4K

config CPU_MIPS24K
	bool
	default y if SOC_CPU_MIPS24K
	select CPU_HAS_TLS

config CPU_MIPS34K
	bool
	default y if SOC_CPU_MIPS34K
	select CPU_HAS_TLS
	select SYS_SUPPORTS_MULTITHREADING
	select MIPS_MT_SMP if SOC_ENABLE_SMP

config CPU_MIPS74K
	bool
	default y if SOC_CPU_MIPS74K
	select CPU_HAS_TLS

config CPU_MIPS1004K
	bool
	default y if SOC_CPU_MIPS1004K
	select CPU_HAS_TLS
	select SYS_SUPPORTS_SMP
	select SYS_SUPPORTS_MULTITHREADING
	select SYS_SUPPORTS_MIPS_CPS
	select MIPS_GIC
	select MIPS_CPS if SOC_ENABLE_CPS
	select MIPS_MT_SMP if SOC_ENABLE_MT
	select WEAK_REORDERING_BEYOND_LLSC
	select CLKSRC_MIPS_GIC
	select COMMON_CLK

config CPU_MIPS1074K
	bool
	default y if SOC_CPU_MIPS1074K
	select CPU_HAS_TLS
	select SYS_SUPPORTS_SMP
	select SYS_SUPPORTS_MIPS_CPS
	select MIPS_GIC
	select MIPS_CPS if SOC_ENABLE_CPS
	select WEAK_REORDERING_BEYOND_LLSC
	select CLKSRC_MIPS_GIC
	select COMMON_CLK

config CPU_MIPSIA
	bool
	default y if SOC_CPU_MIPSIA
	select CPU_HAS_TLS
	select SYS_SUPPORTS_SMP
	select SYS_SUPPORTS_MULTITHREADING
	select SYS_SUPPORTS_MIPS_CPS
	select MIPS_GIC
	select MIPS_CPS if SOC_ENABLE_CPS
	select MIPS_MT_SMP if SOC_ENABLE_MT
	select WEAK_REORDERING_BEYOND_LLSC
	select CLKSRC_MIPS_GIC if !SOC_TIMER
	select COMMON_CLK

config CPU_RLX4181
	bool
	default y if SOC_CPU_RLX4181

config CPU_RLX5181
	bool
	default y if SOC_CPU_RLX5181
	select CPU_HAS_CLS

config CPU_RLX4281
	bool
	default y if SOC_CPU_RLX4281 || SOC_CPU_RLX4381
	default y if SOC_CPU_RLX4271 || SOC_CPU_RLX4371
	select CPU_HAS_TLS
	select SYS_SUPPORTS_SMP if SOC_ENABLE_SMP

config CPU_RLX5281
	bool
	default y if SOC_CPU_RLX5281 || SOC_CPU_RLX5381
	default y if SOC_CPU_RLX5271 || SOC_CPU_RLX5371
	select CPU_HAS_CLS
	select CPU_HAS_TLS
	select SYS_SUPPORTS_SMP if SOC_ENABLE_SMP

#
# CPU features
#
config CPU_HAS_DSP
	bool

config CPU_HAS_FPU
	bool

config CPU_HAS_EMU
	bool

config CPU_HAS_CLS
	bool

config CPU_HAS_TLS
	bool

config CPU_HAS_RADIAX
	bool

config CPU_HAS_SLEEP
	bool

#
# IRQ
#
config IRQ_ICTL
	bool

#
# CACHE
#
config CPU_HAS_SPRAM
	bool

config CPU_HAS_WBC
	bool
	default y

config CPU_HAS_L2C
	bool

config CPU_HAS_AR7
	bool

config CPU_HAS_WBIC
	bool
	default y if SOC_CACHE_WBIC

#
# BUS
#
config HW_HAS_USB
	bool

source "arch/mips/rtl9607c/Kconfig.hook"
```
